## drivers/mcuio/Kconfig
```kconfig
menuconfig MCUIO
	tristate "mcuio drivers"
	select REGMAP_MCUIO
	help
	  MCUIO is a protocol and a set of drivers which let a Linux MPU
	  (MPU = MicroProcessor Unit) control an MCU's peripherals
	  (MCU = Micro Controller Unit, some kind of tiny microcontroller
	  running a tiny OS or no OS at all).

if MCUIO

config MCUIO_LDISC_HC
	tristate "mcuio line discipline host controller"
	default y
	help
	  This adds a line-discipline based MCUIO host controller, which is
	  the only host controller at present. Say Y if in doubt.

config MCUIO_JS_SHIELD
	tristate "mcuio joystick shield driver"
	default y
	help
	  Adds a driver for a joystick + buttons shield (experimental)

config MCUIO_LUCKY_SHIELD
	tristate "mcuio lucky shield driver"
	depends on I2C
	default y
	help
	  Adds a driver for the Dog Hunter Lucky shield (experimental)

config MCUIO_DIGITALIO_SHIELD
	tristate "mcuio Digital I/O shield driver"
	depends on I2C
	default y
	help
	  Adds a driver for the Dog Hunter Digital IO shield (experimental)

config MCUIO_DOGOLED_SHIELD
	tristate "mcuio Dog OLED shield driver"
	depends on (MCUIO && I2C)
	default y
	help
	  Adds a driver for the Dog Hunter Dog OLED shield (experimental)

config MCUIO_SHIELDS_MANUAL_PROBE
	tristate "mcuio shields manual probe"
	default y
	help
	  Since autoprobe of mcuio shields is not implemented yet, this option
	  makes it possible to manually register shields (experimental).

config MCUIO_IRQ_TEST
        tristate "mcuio irq test function driver"
	default n
	help
	  Adds a driver for the irq test mcuio function

endif # MCUIO
```

## drivers/nfc/nfcst/Kconfig
```kconfig
config NFC_ST
	tristate "ST NFC Transceiver driver"
	depends on NFC_DIGITAL
	help
	  This enables the ST NFC transceiver (e.g. CR95HF / ST95HF)
	  core framework. These transceivers implement the
	  digital specifications.
	  The core framework registers with the digital core and
	  implements the digital ops. On the other side, it
	  exposes a framework for the phy drivers. Phy drivers
	  implements ops that are required by the core for
	  communication between the transceiver and the host.
	  Phy driver can be an UART LDisc driver or an SPI slave
	  driver.

	  Say Y here to compile support for ST NFC transceiver core
	  framework into the kernel or say M to compile it as module.

config NFC_ST_UART
	tristate "ST NFC-over-UART driver"
	depends on NFC_DIGITAL && NFC_DIGITAL_UART
	select NFC_ST
	help
	  ST NFC-over-UART driver.

	  This driver is an UART LDisc driver that helps
	  ST NFC transceiver core framework communicate with
	  the transceiver device over the UART interface.
	  The driver registers as a phy driver with the core,
	  and as an LDisc driver with the digital UART LDisc
	  framework.

	  Say Y here to compile support for ST NFC-over-UART driver
	  into the kernel or say M to compile it as module.
```
